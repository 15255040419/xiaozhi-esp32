## main/Kconfig.projbuild
```kconfig
menu "Xiaozhi Assistant"

config OTA_VERSION_URL
    string "OTA Version URL"
    default "https://api.tenclass.net/xiaozhi/ota/"
    help
        The application will access this URL to check for updates.

choice CONNECTION_TYPE
    prompt "Connection Type"
    default CONNECTION_TYPE_MQTT_UDP
    help
        网络数据传输协议
    config CONNECTION_TYPE_MQTT_UDP
        bool "MQTT + UDP"
    config CONNECTION_TYPE_WEBSOCKET
        bool "Websocket"
endchoice

config WEBSOCKET_URL
    depends on CONNECTION_TYPE_WEBSOCKET
    string "Websocket URL"
    default "wss://api.tenclass.net/xiaozhi/v1/"
    help
        Communication with the server through websocket after wake up.

config WEBSOCKET_ACCESS_TOKEN
    depends on CONNECTION_TYPE_WEBSOCKET
    string "Websocket Access Token"
    default "test-token"
    help
        Access token for websocket communication.

choice BOARD_TYPE
    prompt "Board Type"
    default BOARD_TYPE_BREAD_COMPACT_WIFI
    help
        Board type. 开发板类型
    config BOARD_TYPE_BREAD_COMPACT_WIFI
        bool "面包板新版接线（WiFi）"
    config BOARD_TYPE_BREAD_COMPACT_ML307
        bool "面包板新版接线（ML307 AT）"
    config BOARD_TYPE_ESP_BOX_3
        bool "ESP BOX 3"
    config BOARD_TYPE_KEVIN_BOX_1
        bool "Kevin Box 1"
    config BOARD_TYPE_KEVIN_BOX_2
        bool "Kevin Box 2"
    config BOARD_TYPE_KEVIN_C3
        bool "Kevin C3"
    config BOARD_TYPE_LICHUANG_DEV
        bool "立创开发板"
    config BOARD_TYPE_NOMI
        bool "NOMI"
        select AUDIO_CODEC_TYPE_MAX98357
endchoice

choice AUDIO_CODEC_TYPE
    prompt "Audio Codec Type"
    default AUDIO_CODEC_TYPE_MAX98357 if BOARD_TYPE_NOMI
    default AUDIO_CODEC_TYPE_NONE
    config AUDIO_CODEC_TYPE_NONE
        bool "No Audio Codec"
    config AUDIO_CODEC_TYPE_MAX98357
        bool "MAX98357"
    config AUDIO_CODEC_TYPE_ES8311
        bool "ES8311"
endchoice

endmenu
```

## sdkconfig.defaults
```kconfig
# Board configuration
CONFIG_BOARD_TYPE_NOMI=y

# PSRAM configuration
CONFIG_ESP32S3_SPIRAM_SUPPORT=y
CONFIG_SPIRAM_MODE_OCT=y
CONFIG_SPIRAM_SPEED_80M=y
CONFIG_SPIRAM=y
CONFIG_SPIRAM_BOOT_INIT=y
CONFIG_SPIRAM_USE_MALLOC=y
CONFIG_SPIRAM_TYPE_AUTO=y
CONFIG_SPIRAM_SIZE=-1
CONFIG_SPIRAM_MALLOC_ALWAYSINTERNAL=32768
CONFIG_SPIRAM_TRY_ALLOCATE_WIFI_LWIP=y
CONFIG_SPIRAM_MALLOC_RESERVE_INTERNAL=131072
CONFIG_SPIRAM_ALLOW_STACK_EXTERNAL_MEMORY=y

# LVGL configuration
CONFIG_LV_COLOR_16_SWAP=y
CONFIG_LV_MEM_CUSTOM=y
CONFIG_LV_DISP_DEF_REFR_PERIOD=15
CONFIG_LV_USE_GIF=y
CONFIG_LV_USE_DRAW_BUF_SIMPLE=y
CONFIG_LV_DRAW_BUF_ALIGN=1
CONFIG_LV_MEM_SIZE=65536
CONFIG_LV_IMG_CACHE_DEF_SIZE=10
CONFIG_LV_GIF_CACHE_DECODING_DATA=y

# LVGL Hardware Acceleration
CONFIG_LV_USE_GPU=y
CONFIG_LV_USE_GPU_ESP32=y
CONFIG_LV_GPU_DMA_SUPPORT=y
CONFIG_LV_USE_DIRECT_MODE=y
CONFIG_LV_DMA_MAX_TRANSFER_SIZE=4096
CONFIG_LV_DISP_USE_DMA=y
CONFIG_LV_DISP_DEFROTATE=0

# Task configuration
CONFIG_LVGL_TASK_PRIORITY=5
CONFIG_LVGL_TASK_STACK_SIZE=8192
CONFIG_LVGL_TASK_CORE_AFFINITY=1
CONFIG_AUDIO_TASK_PINNED_TO_CORE=0
CONFIG_AUDIO_TASK_PRIORITY=10
CONFIG_AUDIO_TASK_STACK_SIZE=8192

# FreeRTOS configuration
CONFIG_FREERTOS_UNICORE=n
CONFIG_FREERTOS_RUNNING_CORES=2

# Display optimization
CONFIG_LV_USE_PERF_MONITOR=y

# DMA configuration
CONFIG_ESP32S3_GDMA_SUPPORTED=y
CONFIG_ESP32S3_DMA_MAX_BUFFER_SIZE=4096
CONFIG_SPI_DMA_CHAN_AUTO=y
CONFIG_SPI_DMA_CHAN_SEL_AUTO=y

# Watchdog configuration
CONFIG_ESP_TASK_WDT_TIMEOUT_S=10
CONFIG_ESP_TASK_WDT_CHECK_IDLE_TASK_CPU0=n
CONFIG_ESP_TASK_WDT_CHECK_IDLE_TASK_CPU1=n
```
